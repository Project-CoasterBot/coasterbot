#ifndef SRC_SERVOINTERFACE_H
#define SRC_SERVOINTERFACE_H

#include <Arduino.h>
#include <Servo.h>

/** This class controls a positional micro servo (SG90 / MF90) of the coasterbot coaster mechanism.
 *
 * Both servos of the coaster mechanism are positional, not continuous rotation: they are told an
 * angle and hold it. Servo 1 raises and lowers the magnet disc over a crank drive, servo 2 is the
 * pusher that rotates in 90 degree steps.
 *
 * The pulse train itself is generated by the PIO based Servo library of the arduino-pico core, so
 * the timing does not depend on the main loop. Only 8 servos can be attached at once - that is the
 * number of PIO state machines - which is why begin() reports whether it got one.
 *
 * Instantiate with the GPIO number as template argument. min_angle/max_angle are the mechanical
 * limits of the mounted mechanism, every requested angle is clamped into them so a coding mistake
 * cannot drive the mechanism against its end stop. min_pulse_us/max_pulse_us calibrate the servo
 * itself and always describe its full 0..180 degree travel - the datasheet values of the SG90 are
 * the default, cheap clones often need a bit of trimming here.
 *
 * Call begin() once from setup(). Nonblocking usage: setAngle() starts a move and returns
 * immediately, the servo then runs at its own speed. moveTo() ramps the setpoint over a given
 * duration instead, which update() steps forward one increment per call - that is the way to get a
 * slow, controlled lift instead of a jerk. Neither of them uses delay().
 *
 * In every main loop iteration, call the update() method.
 */
template<int pin,
    int min_angle = 0, int max_angle = 180,
    int min_pulse_us = 500, int max_pulse_us = 2400,
    unsigned long release_after_milliseconds = 0
>
class ServoController {

    Servo _servo;
    bool _attached {false};

    int _current_us {0}; // pulse width currently written to the servo
    int _target_us {0};  // pulse width the current movement ends at
    int _start_us {0};   // pulse width the current ramp started from

    unsigned long _ramp_start {0};
    unsigned long _ramp_duration {0};
    bool _ramping {false};

    unsigned long _settled {0}; // when the last movement finished, for release_after_milliseconds

public:

    ServoController() {
        static_assert(pin >= 0);
        static_assert(min_angle >= 0 && max_angle <= 180 && min_angle < max_angle);
        static_assert(min_pulse_us > 0 && max_pulse_us > min_pulse_us);
    }

    /// Attach the servo and hold it at start_angle. Call once from setup().
    /// Returns false if no PIO state machine was free, in that case the servo stays dead.
    bool begin(int start_angle = min_angle) {
        _current_us = angleToPulse(start_angle);
        _start_us = _current_us;
        _target_us = _current_us;
        _ramping = false;
        _settled = now();

        // attach with the start value, so the servo never sees the library default pulse
        _attached = (_servo.attach(pin, min_pulse_us, max_pulse_us, _current_us) >= 0);
        return _attached;
    }

public: // movement setters

    /// Move to an angle at the servos own speed. Returns immediately, nothing to wait for.
    void setAngle(int angle) { moveTo(angle, 0); }

    /// Move to an angle over the given duration, stepped by update(). A duration of 0 behaves
    /// like setAngle(). The ramp limits how fast the setpoint travels, not the servo itself, so
    /// the duration has to be longer than the servo would need on its own to have any effect.
    void moveTo(int angle, unsigned long duration_milliseconds) {
        const int target = angleToPulse(angle);
        if (target == _target_us && _attached && !_ramping) return; // already sitting there

        _target_us = target;
        _start_us = _current_us;
        _ramp_start = now();
        _ramp_duration = duration_milliseconds;
        _ramping = (duration_milliseconds > 0) && (target != _current_us);
        _settled = _ramp_start;

        if (!_ramping) writePulse(target);
    }

    /// Stop driving the servo. It goes limp and stops humming and drawing current, which is worth
    /// doing on battery whenever the mechanism holds its position on its own.
    /// The next setAngle()/moveTo()/hold() picks it up again.
    void release() {
        if (!_attached) return;
        _servo.detach(); // blocks until the current pulse is finished, up to one 20 ms servo period
        _attached = false;
        _ramping = false;
    }

    /// Drive the servo again at its last commanded angle, without moving it.
    void hold() { writePulse(_current_us); }

public: // queries

    /// True while a moveTo() ramp is still running.
    bool isMoving() const { return _ramping; }

    /// True while the servo is actively driven, i.e. not released.
    bool isHolding() const { return _attached; }

    /// The angle currently commanded - during a ramp this is the setpoint, not a measurement.
    /// A servo without feedback cannot tell us where it really is.
    int angle() const { return pulseToAngle(_current_us); }

    int targetAngle() const { return pulseToAngle(_target_us); }

public: // main loop repeated call

    void update() { update(now()); }

    void update(unsigned long curtime) {
        if (_ramping) {
            const unsigned long elapsed = curtime - _ramp_start;

            if (elapsed >= _ramp_duration) {
                writePulse(_target_us);
                _ramping = false;
                _settled = curtime;
                return;
            }

            const long span = static_cast<long>(_target_us) - static_cast<long>(_start_us);
            writePulse(_start_us + static_cast<int>((span * static_cast<long>(elapsed)) / static_cast<long>(_ramp_duration)));
            return;
        }

        if (release_after_milliseconds == 0) return; // keep holding forever
        if (!_attached) return;

        if (static_cast<long>(curtime - (_settled + release_after_milliseconds)) >= 0)
            release();
    }

protected:
    static unsigned long now() { return millis(); }

    /// Map an angle to its pulse width. The calibrated pulse range always describes the full
    /// 0..180 degree travel, min_angle/max_angle only clamp which part of it may be used.
    static int angleToPulse(int angle) {
        if (angle < min_angle) angle = min_angle;
        else if (angle > max_angle) angle = max_angle;

        return min_pulse_us + ((max_pulse_us - min_pulse_us) * angle) / 180;
    }

    static int pulseToAngle(int pulse_us) {
        return ((pulse_us - min_pulse_us) * 180) / (max_pulse_us - min_pulse_us);
    }

    /// Write a pulse width to the servo, attaching it again if it had been released.
    void writePulse(int pulse_us) {
        if (!_attached) {
            _attached = (_servo.attach(pin, min_pulse_us, max_pulse_us, pulse_us) >= 0);
            _current_us = pulse_us;
            return;
        }

        if (pulse_us == _current_us) return; // nothing changed
        _current_us = pulse_us;
        _servo.writeMicroseconds(pulse_us);
    }

};

#endif //SRC_SERVOINTERFACE_H
